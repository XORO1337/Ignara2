## esp-section-room/main/Kconfig.projbuild
```kconfig
menu "Ignara Room Beacon Configuration"

    config IGNARA_BEACON_DEVICE_ID
        string "Room beacon device ID"
        default "beacon-unset"
        help
            Unique identifier for this room-mounted ESP32. Must match the
            `beaconDeviceId` configured on the matching Beacon prop in the
            Ignara map editor.

    config IGNARA_BEACON_ROOM_ID
        string "Room ID covered by this beacon"
        default "room-unset"
        help
            Logical room identifier. Proximity reports from this beacon are
            tagged with this value so the server can route location events.

    config IGNARA_BEACON_ORG_ID
        string "Organization ID"
        default "default-org"

    config IGNARA_WIFI_SSID
        string "WiFi SSID"
        default "Ignara-Office"

    config IGNARA_WIFI_PASSWORD
        string "WiFi password"
        default ""

    config IGNARA_API_HOST
        string "API host (IP or DNS)"
        default "192.168.1.100"

    config IGNARA_API_PORT
        int "API port"
        default 3001
        range 1 65535

    config IGNARA_API_SCHEME_HTTPS
        bool "Use HTTPS for API"
        default n

    config IGNARA_DEVICE_TOKEN
        string "Shared device token (X-Device-Token header)"
        default ""
        help
            Must match ROOM_BEACON_DEVICE_TOKEN in the API's environment.
            Leave blank during development to disable authentication.

    config IGNARA_REPORT_INTERVAL_MS
        int "Report interval (ms)"
        default 5000
        range 1000 60000

    config IGNARA_NOTIFY_POLL_INTERVAL_MS
        int "Notification poll interval (ms)"
        default 3000
        range 500 60000

    config IGNARA_BLE_SCAN_WINDOW_MS
        int "BLE scan window (ms) before a reading is considered stale"
        default 15000
        range 2000 120000

    config IGNARA_BLE_ADV_NAME_PREFIX
        string "Advertising-name prefix used by employee tags"
        default "IGN-EMP-"
        help
            The beacon accepts BLE advertisements whose device name starts
            with this prefix. The remainder of the name is treated as the
            employee ID reported to the server.

    config IGNARA_RELAY_ADV_SECONDS
        int "Seconds to relay a notification over BLE advertising"
        default 15
        range 3 120

endmenu
```

## esp-section-room/sdkconfig.defaults
```kconfig
CONFIG_BT_ENABLED=y
CONFIG_BT_BLUEDROID_ENABLED=y
CONFIG_BT_BLE_ENABLED=y
CONFIG_BT_BLE_50_FEATURES_SUPPORTED=n
CONFIG_BT_GATTS_ENABLE=y
CONFIG_BT_BLE_DYNAMIC_ENV_MEMORY=y

CONFIG_ESP_WIFI_ENABLED=y
CONFIG_LWIP_TCP_MSL=30000

CONFIG_MBEDTLS_TLS_ENABLED=y
CONFIG_MBEDTLS_CERTIFICATE_BUNDLE=y

CONFIG_FREERTOS_HZ=1000
CONFIG_ESP_MAIN_TASK_STACK_SIZE=8192

CONFIG_COMPILER_OPTIMIZATION_SIZE=y

CONFIG_PARTITION_TABLE_SINGLE_APP_LARGE=y
```

## esp-section/main/Kconfig.projbuild
```kconfig
menu "Ignara Employee Tag Configuration"

    config IGNARA_EMPLOYEE_NAME
        string "Employee name"
        default "Unset Employee"
        help
            Human-readable employee name associated with this tag.
            Set this value via `idf.py menuconfig` before flashing.

    config IGNARA_EMPLOYEE_ID
        string "Employee ID (broadcast via BLE)"
        default "emp-000"
        help
            Stable identifier used by the server to track this employee. The
            room-mounted beacon scans for this ID in the BLE advertisement and
            reports proximity readings keyed on it.
            Set this value via `idf.py menuconfig` before flashing.

endmenu
```
